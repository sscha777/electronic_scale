
#include <stdint.h>
#include <stdio.h>
#include <stdlib.h>
#include <string.h>
#include <sys/time.h>
#include "esp_log.h"
#include "eve/EVE.h"
#include "eve/EVE_target.h"
#include "eve/EVE_commands.h"
#include "intro.h"
#include "tft.h"
#include "scspiffs.h"

static void (*Touch_Callback)(INTRO_EVENTS event) = 0;

// static const char *TAG = "intro";
extern SCALE_SCENARIO newScenario;
extern SCALE_SCENARIO currentScenario;

const uint8_t pic[59250] PROGMEM = {
    120, 156, 237, 157, 127, 104, 219, 104, 154, 199, 21, 46,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 217,
    28, 23, 113, 57, 38, 102, 2, 91, 95, 179, 16, 155,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 226,
    14, 76, 113, 10, 45, 78, 160, 110, 156, 97, 51, 184,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 217,
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    14, 127, 3, 149, 124, 160,
    48};

void touch_calibrate(void)
{

/* activate this if you are using a module for the first time or if you need to re-calibrate it */
/* write down the numbers on the screen and either place them in one of the pre-defined blocks above or make a new block */
#if 1
    /* calibrate touch and displays values to screen */
    if (scaleInfo.touch_cali_flag)
    {
        EVE_cmd_dl(CMD_DLSTART);
        EVE_cmd_dl(DL_CLEAR_RGB | BLACK);
        EVE_cmd_dl(DL_CLEAR | CLR_COL | CLR_STN | CLR_TAG);
        EVE_cmd_text((EVE_HSIZE / 2), 50, 26, EVE_OPT_CENTER, "Please tap on the dot.");
        EVE_cmd_calibrate();
        EVE_cmd_dl(DL_DISPLAY);
        EVE_cmd_dl(CMD_SWAP);
        EVE_cmd_execute();

        uint32_t touch_a, touch_b, touch_c, touch_d, touch_e, touch_f;

        touch_a = EVE_memRead32(REG_TOUCH_TRANSFORM_A);
        touch_b = EVE_memRead32(REG_TOUCH_TRANSFORM_B);
        touch_c = EVE_memRead32(REG_TOUCH_TRANSFORM_C);
        touch_d = EVE_memRead32(REG_TOUCH_TRANSFORM_D);
        touch_e = EVE_memRead32(REG_TOUCH_TRANSFORM_E);
        touch_f = EVE_memRead32(REG_TOUCH_TRANSFORM_F);

        calibrationvalues.TouchTransform_X[0] = touch_a;
        calibrationvalues.TouchTransform_X[1] = touch_b;
        calibrationvalues.TouchTransform_X[2] = touch_c;
        calibrationvalues.TouchTransform_X[3] = touch_d;
        calibrationvalues.TouchTransform_X[4] = touch_e;
        calibrationvalues.TouchTransform_X[5] = touch_f;
        saveTouch(&calibrationvalues.TouchTransform_X[0]);

        EVE_cmd_dl(CMD_DLSTART);
        EVE_cmd_dl(DL_CLEAR_RGB | BLACK);
        EVE_cmd_dl(DL_CLEAR | CLR_COL | CLR_STN | CLR_TAG);
        EVE_cmd_dl(TAG(0));

        EVE_cmd_text(5, 15, 26, 0, "TOUCH_TRANSFORM_A:");
        EVE_cmd_text(5, 30, 26, 0, "TOUCH_TRANSFORM_B:");
        EVE_cmd_text(5, 45, 26, 0, "TOUCH_TRANSFORM_C:");
        EVE_cmd_text(5, 60, 26, 0, "TOUCH_TRANSFORM_D:");
        EVE_cmd_text(5, 75, 26, 0, "TOUCH_TRANSFORM_E:");
        EVE_cmd_text(5, 90, 26, 0, "TOUCH_TRANSFORM_F:");

#if defined(FT81X_ENABLE)
        EVE_cmd_setbase(16L); /* FT81x only */
        EVE_cmd_number(310, 15, 26, EVE_OPT_RIGHTX | 8, touch_a);
        EVE_cmd_number(310, 30, 26, EVE_OPT_RIGHTX | 8, touch_b);
        EVE_cmd_number(310, 45, 26, EVE_OPT_RIGHTX | 8, touch_c);
        EVE_cmd_number(310, 60, 26, EVE_OPT_RIGHTX | 8, touch_d);
        EVE_cmd_number(310, 75, 26, EVE_OPT_RIGHTX | 8, touch_e);
        EVE_cmd_number(310, 90, 26, EVE_OPT_RIGHTX | 8, touch_f);
#else
        EVE_cmd_number(310, 15, 26, EVE_OPT_RIGHTX, touch_a);
        EVE_cmd_number(310, 30, 26, EVE_OPT_RIGHTX, touch_b);
        EVE_cmd_number(310, 45, 26, EVE_OPT_RIGHTX, touch_c);
        EVE_cmd_number(310, 60, 26, EVE_OPT_RIGHTX, touch_d);
        EVE_cmd_number(310, 75, 26, EVE_OPT_RIGHTX, touch_e);
        EVE_cmd_number(310, 90, 26, EVE_OPT_RIGHTX, touch_f);
#endif

        EVE_cmd_dl(DL_DISPLAY); /* instruct the graphics processor to show the list */
        EVE_cmd_dl(CMD_SWAP);   /* make this list active */
        EVE_cmd_execute();

        while (1)
            ;
    }
#endif
/* send pre-recorded touch calibration values, depending on the display the code is compiled for */

/*
2022.04.13. 직접 측정해서 넣음 -> 저장해서 호출하는 방식으로 바꿔야 함.
*/
#if 1

    // calibrationvalues.TouchTransform_X[0] = 0x0000d380;
    // calibrationvalues.TouchTransform_X[1] = 0xffffff0d;
    // calibrationvalues.TouchTransform_X[2] = 0xffee797f;
    // calibrationvalues.TouchTransform_X[3] = 0x00000092;
    // calibrationvalues.TouchTransform_X[4] = 0xffff7b47;
    // calibrationvalues.TouchTransform_X[5] = 0x01f774b1;

    EVE_memWrite32(REG_TOUCH_TRANSFORM_A, calibrationvalues.TouchTransform_X[0]);
    EVE_memWrite32(REG_TOUCH_TRANSFORM_B, calibrationvalues.TouchTransform_X[1]);
    EVE_memWrite32(REG_TOUCH_TRANSFORM_C, calibrationvalues.TouchTransform_X[2]);
    EVE_memWrite32(REG_TOUCH_TRANSFORM_D, calibrationvalues.TouchTransform_X[3]);
    EVE_memWrite32(REG_TOUCH_TRANSFORM_E, calibrationvalues.TouchTransform_X[4]);
    EVE_memWrite32(REG_TOUCH_TRANSFORM_F, calibrationvalues.TouchTransform_X[5]);

#endif
}

/**
 * @brief
 *
 * @param touchcallback
 * @param closefunction
 * @return void*
 */

// void *introGuiStart(void (*touchcallback)(INTRO_EVENTS event), void (**closefunction)())
void *introGuiStart(void (*touchcallback)(INTRO_EVENTS event))
{
    introDisplay();
    Touch_Callback = touchcallback;
    // closefunction = 0;
    return introLoop;
}

void introLoop(void)
{
    static uint32_t tick = 0;
    uint8_t TouchTag = TouchInput();

    if (TouchTag == INTRO_ENTER)
    {
        //ESP_LOGI(TAG, "Touch(%d)\n", TouchTag);
        (*Touch_Callback)(TouchTag);
    }

    tick++;
    if (tick > 50)
    {
        //ESP_LOGE(TAG, "tick 100");
        newScenario = MAIN_SCALE_SCENARIO;
        tick = 0;
        EVE_bitmap_load();
    }
}

void IntroTouchCallback(INTRO_EVENTS event)
{
    //ESP_LOGE(TAG, "initTouchCallback");

    switch (event)
    {
    case INTRO_ENTER:
        newScenario = MAIN_SCALE_SCENARIO;
        break;
    default:
        break;
    }

    if (event == INTRO_ENTER)
    {
        EVE_sound_play(0x50, AUDIO_VOLUME);
    }
}

void introDisplay(void)
{
    //ESP_LOGE(TAG, "introDisplay start");

    // EVE_sound_play(0x47, AUDIO_VOLUME);

    EVE_cmd_dl(CMD_DLSTART); /* Start the display list */
    EVE_cmd_dl(TAG(0));      /* do not use the following objects for touch-detection */
    EVE_cmd_bgcolor(BLACK);

    EVE_cmd_inflate(MEM_LOGO, pic, sizeof(pic));
    EVE_cmd_setbitmap(MEM_LOGO, EVE_RGB565, 237, 125);
    EVE_cmd_dl(VERTEX_FORMAT(0)); /* reduce precision for VERTEX2F to 1 pixel instead of 1/16 pixel default */
    EVE_cmd_dl(CLEAR(1, 1, 1));
    EVE_cmd_dl(DL_BEGIN | EVE_BITMAPS);
    EVE_cmd_dl(VERTEX2F(277, 152));
    EVE_cmd_dl(DL_END);
    EVE_cmd_text(223, 379, 29, 0, "Food Management System Compay");

    EVE_cmd_dl(DL_DISPLAY); /* instruct the graphics processor to show the list */
    EVE_cmd_dl(CMD_SWAP);   /* make this list active */
    EVE_cmd_execute();
}
